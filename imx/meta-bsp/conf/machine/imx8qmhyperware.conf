## imx/meta-bsp/conf/machine/imx8qmhyperware.conf
```bitbake
#@TYPE: Machine
#@NAME: i.MX 8QM B0 MEK
#@DESCRIPTION: i.MX 8QuadMax Multisensory Enablement Kit (MEK) board
#@MAINTAINER: Jun Zhu <junzhu@nxp.com>

MACHINEOVERRIDES =. "mx8:mx8qm:"

require conf/machine/include/imx-base.inc
require conf/machine/include/arm/arch-arm64.inc

# MACHINE_FEATURES_append = " optee qca6174 bcm43455 bcm4356 bcm4359"
MACHINE_FEATURES_append = " qca6174 bcm43455 bcm4356 bcm4359"

# Don't include kernels in standard images
RDEPENDS_${KERNEL_PACKAGE_NAME}-base = ""
RDEPENDS_${KERNEL_PACKAGE_NAME}-image = ""

LOADADDR = ""

# Disable the serial console due to auto-serial-console
SERIAL_CONSOLES = "115200;ttyAMA0"

# we do not want to have getty running on tty1 as we run
# auto-serial-console there
USE_VT = "0"

KERNEL_DEVICETREE = "freescale/fsl-imx8qm-hyperware.dtb freescale/fsl-imx8qm-hyperware-dom0.dtb"

UBOOT_MAKE_TARGET = \
    "${@bb.utils.contains('COMBINED_FEATURES', 'optee', '', \
                                                        'u-boot.bin', d)}"
SPL_BINARY = \
    "${@bb.utils.contains('COMBINED_FEATURES', 'optee', 'spl/u-boot-spl.bin', \
                                                        '', d)}"
UBOOT_SUFFIX = "bin"
UBOOT_CONFIG ??= "sd"
UBOOT_CONFIG_SD = \
    "${@bb.utils.contains('COMBINED_FEATURES', 'optee', 'imx8qm_hyperware_spl_defconfig', \
                                                        'imx8qm_hyperware_defconfig', d)}"
UBOOT_CONFIG_FSPI = \
    "${@bb.utils.contains('COMBINED_FEATURES', 'optee', 'imx8qm_hyperware_spl_fspi_defconfig', \
                                                        'imx8qm_hyperware_fspi_defconfig', d)}"
UBOOT_CONFIG[sd]   = "${UBOOT_CONFIG_SD},sdcard"
UBOOT_CONFIG[fspi] = "${UBOOT_CONFIG_FSPI}"

BOOT_SPACE = "65536"
IMAGE_BOOTLOADER = "imx-boot"
IMX_BOOT_SEEK = "32"

IMAGE_BOOTFILES_DEPENDS += "firmware-imx:do_deploy"
IMAGE_BOOTFILES += "hdmitxfw.bin hdmirxfw.bin dpfw.bin"

BOARD_TYPE = "mek"

IMXBOOT_TARGETS_SD = \
    "${@bb.utils.contains('COMBINED_FEATURES', 'optee', 'flash_linux_m4 flash_spl', \
                                                        'flash', d)}"
IMXBOOT_TARGETS_FSPI = \
    "${@bb.utils.contains('COMBINED_FEATURES', 'optee', 'flash_spl_flexspi', \
                                                        'flash_flexspi', d)}"
IMXBOOT_TARGETS = \
    "${@bb.utils.contains('UBOOT_CONFIG',         'sd', '${IMXBOOT_TARGETS_SD}', \
                                                        '${IMXBOOT_TARGETS_FSPI}', d)}"
```
